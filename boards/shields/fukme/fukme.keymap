#include <behaviors.dtsi>
#include <dt-bindings/zmk/keys.h>
#include <dt-bindings/zmk/bt.h>

#define DEFAULT 0

/ {
    keymap {
        compatible = "zmk,keymap";

        DEFAULT { // Layer 0
            // ------------------------
            // |     F     |     bt_reset     |
            bindings = <
                &kp F   &bt BT_CLR    
            >;

            sensor-bindings = <&inc_dec_kp C_VOL_UP C_VOL_DN &inc_dec_kp C_BRI_UP C_BRI_DN>;
     
        };
    };
 };