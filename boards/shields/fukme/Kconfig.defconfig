## boards/shields/fukme/Kconfig.defconfig
```kconfig
if SHIELD_FUKME

# Name must be less than 16 characters long!
config ZMK_KEYBOARD_NAME
    default "fukme"

    config SPI
        default y
    
    config SSD16XX
       default y

    config LV_Z_VDB_SIZE
    default 100

    config LV_DPI_DEF
        default 130

    config LV_Z_BITS_PER_PIXEL
        default 1

    choice LV_COLOR_DEPTH
        default LV_COLOR_DEPTH_1
    endchoice

    config ZMK_DISPLAY_BLANK_ON_IDLE
    default n

    config HEAP_MEM_POOL_SIZE
        default 1024

    config LV_Z_MEM_POOL_SIZE
        default 4096
    
    config LV_USE_THEME_MONO
        default y

endif
```

## boards/shields/fukme/Kconfig.shield
```kconfig
# No whitespace after the comma or in your keyboard name!
config SHIELD_FUKME
    def_bool $(shields_list_contains,fukme)
```
